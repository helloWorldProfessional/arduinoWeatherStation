#include <ESP8266WiFi.h>           // Use this for WiFi instead of Ethernet.h
#include <MySQL_Connection.h>
#include <MySQL_Cursor.h>
#include <SPI.h>               // include Arduino SPI library
#include <Adafruit_GFX.h>      // include adafruit graphics library
#include <Adafruit_PCD8544.h>  // include adafruit PCD8544 (Nokia 5110) library
#include <DHT.h>
#include <stdlib.h>

// Nokia 5110 LCD module connections (CLK, DIN, DC, CE, RST)
Adafruit_PCD8544 display = Adafruit_PCD8544(D4, D3, D2, D1, D0);

#define DHTPIN  D5           // DHT22 data pin is connected to NodeMCU pin D5
#define DHTTYPE DHT22        // DHT22 sensor is used
DHT dht22(DHTPIN, DHTTYPE);  // configure DHT library 

// MySql Server info
IPAddress server_addr(37,59,55,185);  // IP of the MySQL server 
char user[] = "";              // MySQL user login username
char password[] = "";        // MySQL user login password

// Query
char INSERT_SQL[] = "INSERT INTO zGkeKAQ464.ova (b) VALUES (%d)";
const char SELECT_SQL[] = "SELECT vr from zGkeKAQ464.ova ORDER BY id DESC LIMIT 1";
char query[128];

// WiFi connection 
char ssid[] = "";         // SSID
char pass[] = "";     // SSID Password
WiFiClient client;                 
MySQL_Connection conn(&client);
MySQL_Cursor* cursor;

// YL-69 sensor
int SMoist=A0;
int value=0;
int tresholdValue=600;
int trig=0;
// Watering can logo
static const unsigned char PROGMEM WPLogo[] =
{
0x00, 0x00, 0x01, 0xe0, 0x00, 0x00, 0x00, 0x00, 0x00, 0x00, 0x00, 0x00, 0x00, 0x07, 0xd0, 0x00, 
0x06, 0x00, 0x00, 0x00, 0x00, 0x00, 0x00, 0x00, 0x0a, 0x6f, 0xc0, 0x3b, 0x00, 0x00, 0x00, 0x00, 
0x00, 0x00, 0x00, 0x1c, 0x3b, 0xf0, 0x7d, 0x00, 0x00, 0x00, 0x00, 0x00, 0x00, 0x00, 0x38, 0x1b, 
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0x00, 0x00, 0x00, 0x00, 0x00, 0x00, 0x00, 0x00, 0x00, 0x00, 0x00, 0x00, 0x00, 0x00, 0x00, 0x00
};

//IoT Logo
static const unsigned char PROGMEM IoTLogo[] =
{

0xff, 0xff, 0xff, 0xff, 0xff, 0xff, 0xff, 0xff, 0xff, 0xff, 0xf0, 0xff, 0xff, 0xff, 0xff, 0xff, 
0xff, 0xff, 0xff, 0xff, 0xff, 0xf0, 0xff, 0xff, 0xff, 0xff, 0xff, 0xff, 0xff, 0xff, 0xff, 0xff, 
0xf0, 0xff, 0xff, 0xff, 0xff, 0xff, 0xe0, 0x7f, 0xff, 0xff, 0xff, 0xf0, 0xff, 0xff, 0xff, 0xff, 
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0xff, 0xff, 0xff, 0xff, 0xf0, 0xff, 0xff, 0xff, 0xff, 0xff, 0xff, 0xff, 0xff, 0xff, 0xff, 0xf0
};

// inserting data into database
void Upload(){
  if (conn.connect(server_addr, 3306, user, password)){
    cursor = new MySQL_Cursor(&conn);
    sprintf(query, INSERT_SQL ,33);
    cursor->execute(query);
    delay(500);
    delete cursor;
 }
  else{
    Serial.println("CONNECTION TO MYSQL SERVER FAILED, RESET MODULE!");
  }
  conn.close();
  delay(1000);
}   
//counting time for upload
unsigned long currentM;
unsigned long startM;
unsigned long period;

void setup()
{
  Serial.begin(115200);
  pinMode(SMoist, INPUT);
  startM=millis();
  display.begin();
  display.setContrast(60);
  display.clearDisplay();
  display.display();
  display.drawBitmap(0, 0,  IoTLogo, 84, 48, 1);
  display.display();
  delay(1000);
  display.clearDisplay();
  dht22.begin();
     
  // WiFi section
  Serial.printf("\nConnecting to %s", ssid);
  WiFi.begin(ssid, pass);
  while (WiFi.status() != WL_CONNECTED) {
    delay(500);
    Serial.print(".");
    display.clearDisplay();
    display.setCursor(1, 17);
    display.print("Connecting to network...");
    display.display();
  }
  display.clearDisplay();
  display.display();
  
  // print out info about the connection
  Serial.println("\nConnected to network: ");
  Serial.print(ssid);
  Serial.println("IP address is: ");
  Serial.print(WiFi.localIP());
  display.setCursor(0, 4);
  display.print("Connected to:");
  display.setCursor(1, 14);
  display.setTextColor(WHITE, BLACK);
  display.print(ssid);
  display.setCursor(0, 24);
  display.setTextColor(BLACK,WHITE);
  display.println("IP address:");
  display.setCursor(0, 34);
  display.setTextColor(WHITE, BLACK);
  display.print(WiFi.localIP());
  display.display();
  display.setTextColor(BLACK,WHITE);
  display.clearDisplay();
  display.display();
}
void loop()
{
  int value = analogRead(SMoist);
  int Humi = dht22.readHumidity() * 10;
  int Temp = dht22.readTemperature() * 10;
  delay(500);
  currentM=millis();
  if(currentM-startM>=period || trig==0){
    Upload();
    startM=currentM;
    trig=1;
  } 
  if(value > tresholdValue){
    display.setCursor(0, 40);
    display.print("SH: etooo");
    display.display();
  }
  if (conn.connect(server_addr, 3306, user, password)){
    cursor = new MySQL_Cursor(&conn);
    row_values *row = NULL;
    String data;
    cursor->execute(SELECT_SQL);
    column_names *columns = cursor->get_columns();
    do {
      row = cursor->get_next_row();
      if (row != NULL) {
        data = row->values[0];
      }
    } while (row != NULL);
    
    delay(500);
    delete cursor;
       
  // Show date and time  
  display.clearDisplay();
  String datum;
  datum=data.substring(8,10);
  datum+=data.substring(4,8);
  datum+=data.substring(0,4);
  
  display.setCursor(0,0);
  display.print(datum);
  String str=data.substring(11,13);
  char s[]={str[0],str[1]};
  int vr;
  vr=atoi(s);
  if(vr==16){
    display.setCursor(0, 8);
    display.print("00"+data.substring(13,19));
  }
  else if(vr<9){
    vr+=1;
    display.setCursor(0, 8);
    display.print("0"+vr+data.substring(13,19));
  }
  else{
    vr+=1;
    display.setCursor(0, 8);
    display.print(vr+data.substring(13,19));
  }
 }
  else{
    Serial.println("CONNECTION TO MYSQL SERVER FAILED, RESET MODULE!");
    display.clearDisplay();
    display.setCursor(0, 20);
    display.print("Connection to MySQL failed, reset module...");
    display.display();
  }
  conn.close();
  delay(15000); 
  // display temperature (in °C) and humidity (in %)
  display.drawFastHLine(0, 17, display.width(), BLACK);
  display.setCursor(0, 19);
  display.print("T: ");
  if(Temp < 0) 
    display.printf("-%02u.%1u C", (abs(Temp)/10)%100, abs(Temp) % 10);
  else            // temperature >= 0
    display.printf("%02u.%1u C", (Temp/10)%100, Temp % 10);
    
  display.drawRect(44, 19, 3, 3, BLACK);
  display.setCursor(0, 28);
  display.print("H: ");
  display.printf("%02u.%1u %%", (Humi/10)%100, Humi % 10);
  display.drawFastHLine(0, 37, display.width(), BLACK);
  display.setCursor(0, 40);
  display.print("SH: ");
  value=map(value,200,1023,100,0);
  display.printf("%d", value);
  display.display();
}
